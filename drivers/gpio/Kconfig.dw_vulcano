## drivers/gpio/Kconfig.dw_vulcano
```kconfig
# DesignWare GPIO configuration options

# Copyright (c) 2016 Intel Corporation
# SPDX-License-Identifier: Apache-2.0

config GPIO_DW_VULCANO
	bool "Designware GPIO Vulcano"
	default y
	depends on DT_HAS_SNPS_DESIGNWARE_GPIO_VULCANO_ENABLED
	help
	  Enable driver for Designware GPIO Vulcano
```
